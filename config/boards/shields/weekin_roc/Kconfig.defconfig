## config/boards/shields/weekin_roc/Kconfig.defconfig
```kconfig
# Copyright (c) 2022 The ZMK Contributors
# SPDX-License-Identifier: MIT

if SHIELD_WEEKIN_ROC

config ZMK_KEYBOARD_NAME
    default "Weekin ROC"

endif
```
